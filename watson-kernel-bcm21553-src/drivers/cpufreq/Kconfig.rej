## watson-kernel-bcm21553-src/drivers/cpufreq/Kconfig.rej
```kconfig
--- Kconfig
+++ Kconfig
@@ -229,6 +239,23 @@  config CPU_FREQ_GOV_SCHEDUTIL
 
 	  If in doubt, say N.
 
+config CPU_FREQ_GOV_INTERACTIVE
+	tristate "'interactive' cpufreq policy governor"
+	help
+	  'interactive' - This driver adds a dynamic cpufreq policy governor
+	  designed for latency-sensitive workloads.
+
+	  This governor attempts to reduce the latency of clock
+	  increases so that the system is more responsive to
+	  interactive workloads.
+
+	  To compile this driver as a module, choose M here: the
+	  module will be called cpufreq_interactive.
+
+	  For details, take a look at linux/Documentation/cpu-freq.
+
+	  If in doubt, say N.
+
 comment "CPU frequency scaling drivers"
 
 config CPUFREQ_DT
```

## watson-kernel-bcm21553-src/drivers/staging/bcm21553/drivers/video/bmem/Kconfig
```kconfig
# BMEM
config BMEM
	tristate "BMEM support"
	depends on BRCM_MODULES && BRCM_MODULES_PRIV && BMEM_WRAP
	default N
	help
		Broadcom Unified Memory Allocator device driver support

config BMEM_SIZE
	int "BMEM allocation size"
	depends on BMEM
	default 60
	help
		Broadcom Unified Memory Allocator allocation size
```
